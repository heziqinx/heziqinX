## board/samsung/qt2440/Kconfig
```kconfig
#
#heziqin qt2440 samsung arm920t
#

if TARGET_QT2440

config SYS_BOARD
	default "qt2440"

config SYS_VENDOR
	default "samsung"

config SYS_SOC
	default "s3c24x0"

config SYS_CONFIG_NAME
	default "qt2440"
#endif
```
